## west.yml
```yaml
manifest:
  remotes:
    - name: gh
      url-base: https://github.com/ElectroStar
      
  projects:
    - name: component-c
      remote: gh
      path: project/components/comp_c
      revision: v2.0.0
```
